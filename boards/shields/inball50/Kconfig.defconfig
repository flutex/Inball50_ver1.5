## boards/shields/inball50/Kconfig.defconfig
```kconfig
if SHIELD_INBALL50_LEFT

config ZMK_KEYBOARD_NAME
    default "inball50"

endif

if SHIELD_INBALL50_LEFT || SHIELD_INBALL50_RIGHT

config ZMK_SPLIT
    default y

endif
```

## boards/shields/inball50/Kconfig.shield
```kconfig
config SHIELD_INBALL50_LEFT
    def_bool $(shields_list_contains,inball50_left)
config SHIELD_INBALL50_RIGHT
    def_bool $(shields_list_contains,inball50_right)
```
